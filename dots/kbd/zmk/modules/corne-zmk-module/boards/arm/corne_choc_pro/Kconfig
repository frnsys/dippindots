## dots/kbd/zmk/modules/corne-zmk-module/boards/arm/corne_choc_pro/Kconfig
```kconfig
# SPDX-License-Identifier: MIT

config BOARD_ENABLE_DCDC
	bool "Enable DCDC mode"
	select SOC_DCDC_NRF52X
	default y
	depends on (BOARD_CORNE_CHOC_PRO_LEFT || BOARD_CORNE_CHOC_PRO_RIGHT)
```

## dots/kbd/zmk/modules/corne-zmk-module/boards/arm/corne_choc_pro/Kconfig.board
```kconfig
# Copyright (c) 2020 The ZMK Contributors
# SPDX-License-Identifier: MIT

config BOARD_CORNE_CHOC_PRO_LEFT
	bool "Corne Choc Pro Left"
	depends on SOC_NRF52840_QIAA

config BOARD_CORNE_CHOC_PRO_RIGHT
    bool "Corne Choc Pro Right"
    depends on SOC_NRF52840_QIAA
```

## dots/kbd/zmk/modules/corne-zmk-module/boards/arm/corne_choc_pro/Kconfig.defconfig
```kconfig
# Copyright (c) 2020 The ZMK Contributors
# SPDX-License-Identifier: MIT

if BOARD_CORNE_CHOC_PRO_LEFT

config ZMK_KEYBOARD_NAME
	default "Corne Choc Pro"

config ZMK_SPLIT_ROLE_CENTRAL
    default y

endif # BOARD_CORNE_CHOC_PRO_LEFT

if BOARD_CORNE_CHOC_PRO_LEFT || BOARD_CORNE_CHOC_PRO_RIGHT 

config BOARD
    default "corne_choc_pro"

config ZMK_SPLIT
    default y

if USB

config USB_NRFX
	default y

config USB_DEVICE_STACK
	default y

endif # USB

config BT_CTLR
	default BT

config I2C
	default y

config ZMK_MAX17048
    default y

endif # BOARD_CORNE_CHOC_PRO_LEFT || BOARD_CORNE_CHOC_PRO_RIGHT
```

## dots/kbd/zmk/modules/corne-zmk-module/boards/shields/nice_view_disp/Kconfig.shield
```kconfig
# Copyright (c) 2022 The ZMK Contributors
# SPDX-License-Identifier: MIT

config SHIELD_NICE_VIEW_DISP
    def_bool $(shields_list_contains,nice_view_disp)
```

## dots/kbd/zmk/modules/urchin-zmk-module/boards/shields/urchin/Kconfig.defconfig
```kconfig
# Copyright (c) 2022 Duccio Breschi
# SPDX-License-Identifier: MIT

if SHIELD_URCHIN_LEFT

config ZMK_KEYBOARD_NAME
    default "urchin"

config ZMK_SPLIT_ROLE_CENTRAL
    default y

endif

if SHIELD_URCHIN_LEFT || SHIELD_URCHIN_RIGHT
config ZMK_SPLIT
    default y
endif
```

## dots/kbd/zmk/modules/urchin-zmk-module/boards/shields/urchin/Kconfig.shield
```kconfig
# Copyright (c) 2022 Duccio Breschi
# SPDX-License-Identifier: MIT

config SHIELD_URCHIN_LEFT
    def_bool $(shields_list_contains,urchin_left)

config SHIELD_URCHIN_RIGHT
    def_bool $(shields_list_contains,urchin_right)
```
